## firmware/esp-idf/main/Kconfig.projbuild
```kconfig
menu "BeetMeister Configuration"

    orsource "$IDF_PATH/examples/common_components/env_caps/$IDF_TARGET/Kconfig.env_caps"

    config BEET_STATUS_LED_GPIO
        int "Status LED GPIO number"
        range ENV_GPIO_RANGE_MIN ENV_GPIO_OUT_RANGE_MAX
        default 48
        help
            GPIO number used for the onboard WS2812 status LED.

    config BEET_STATUS_LED_BRIGHTNESS
        int "Status LED brightness"
        range 1 64
        default 16
        help
            Brightness value applied to the WS2812 status LED.

    config BEET_STATUS_LOG_PERIOD_S
        int "Controller status log period in seconds"
        range 5 300
        default 15
        help
            Periodic diagnostic log interval for the controller task.

    config BEET_SENSOR_SAMPLE_COUNT
        int "ADC samples per measurement"
        range 1 32
        default 8
        help
            Number of ADC oneshot samples averaged for each sensor and battery reading.

    config BEET_BATTERY_SAMPLE_OVERLAY_COUNT
        int "Battery measurements overlaid per refresh"
        range 1 16
        default 4
        help
            Number of full battery measurements overlaid into one battery refresh result.
            Each overlaid measurement already averages CONFIG_BEET_SENSOR_SAMPLE_COUNT raw ADC
            conversions, so increasing this value trades latency for a calmer battery reading and
            more stable sleep-state transitions.

    config BEET_BATTERY_DIVIDER_SCALE_PERMILLE
        int "Battery divider scale in permille"
        range 1000 4000
        default 2005
        help
            Divider-only scaling from ADC pin millivolts to source millivolts. The default 2005
            reflects the measured GPIO2 divider built from approximately 149.2 kOhm over
            148.5 kOhm, which is slightly above an ideal 2:1 ratio.

    config BEET_BATTERY_ADC_CALIBRATION_PERMILLE
        int "Battery ADC correction factor in permille"
        range 900 1200
        default 1030
        help
            Battery-path correction applied after the divider scaling. Keep this separate from the
            divider factor so battery-channel trim does not affect moisture channels. The default
            1030 comes from the current USB-powered bench calibration, where GPIO2 plus ADC curve
            fitting and the measured divider values read about 3.296 V when the multimeter reads
            3.326 V.

    config BEET_MOISTURE_SENSOR_SUPPLY_KNEE_MV
        int "Moisture sensor supply knee in millivolts"
        range 2500 3600
        default 3332
        help
            Capacitive moisture sensors on this board are not fully supply-independent. Bench data
            shows that above roughly 3.332 V supply the dry output stays flat, but below that point
            the sensor loses output headroom almost 1:1 with the battery rail. The firmware adds
            back the missing headroom below this knee before applying the dry/wet calibration so
            default calibration stays usable across the supported battery range.

    config BEET_SENSOR_POWER_GPIO
        int "Moisture sensor power enable GPIO number"
        range ENV_GPIO_RANGE_MIN ENV_GPIO_OUT_RANGE_MAX
        default 15
        help
            GPIO used to switch the shared moisture sensor supply rail.

    config BEET_SENSOR_POWER_SETTLE_MS
        int "Moisture sensor settle time in milliseconds"
        range 1 1000
        default 50
        help
            Delay between enabling the shared sensor supply and taking the batched moisture reads.

    config BEET_BOOST_ENABLE_GPIO
        int "Pump and relay boost enable GPIO number"
        range ENV_GPIO_RANGE_MIN ENV_GPIO_OUT_RANGE_MAX
        default 16
        help
            GPIO used to enable the pump and relay DC-DC boost converter.

    config BEET_ENABLE_OLED_DISPLAY
        bool "Enable SSD1306 OLED status display"
        default y
        help
            Enables a small SSD1306 I2C status display used for local controller state during
            bring-up and standalone operation.

    config BEET_OLED_SDA_GPIO
        int "OLED SDA GPIO number"
        range ENV_GPIO_RANGE_MIN ENV_GPIO_OUT_RANGE_MAX
        default 11
        depends on BEET_ENABLE_OLED_DISPLAY
        help
            GPIO used for the SSD1306 I2C data line.

    config BEET_OLED_SCL_GPIO
        int "OLED SCL GPIO number"
        range ENV_GPIO_RANGE_MIN ENV_GPIO_OUT_RANGE_MAX
        default 12
        depends on BEET_ENABLE_OLED_DISPLAY
        help
            GPIO used for the SSD1306 I2C clock line.

    config BEET_OLED_I2C_ADDRESS
        hex "OLED I2C address"
        range 0x3C 0x3D
        default 0x3C
        depends on BEET_ENABLE_OLED_DISPLAY
        help
            SSD1306 I2C address. Most 128x64 modules use 0x3C.

    config BEET_ENABLE_PUMP_OUTPUTS
        bool "Enable live pump output actuation"
        default n
        help
            Keep this disabled during bench bring-up. When disabled, the controller still evaluates
            sensors and scheduler timing but will not energize relay outputs for watering.

    config BEET_ENABLE_BENCH_DIAGNOSTICS
        bool "Enable bench diagnostics logging"
        default y
        help
            Periodically emit parseable ADC and pair-state diagnostics for bench bring-up.

    config BEET_BENCH_DIAGNOSTIC_PERIOD_S
        int "Bench diagnostics log period in seconds"
        range 2 300
        default 10
        depends on BEET_ENABLE_BENCH_DIAGNOSTICS
        help
            Interval for parseable bench diagnostics logs.

    config BEET_ENABLE_RELAY_SELF_TEST
        bool "Enable relay self-test routine"
        default n
        help
            Cycles one relay output at a time for bench validation even when live watering outputs
            remain disabled. Use only when pumps are disconnected or the relay board is safely isolated.

    config BEET_RELAY_SELF_TEST_DWELL_MS
        int "Relay self-test dwell in milliseconds"
        range 100 10000
        default 1500
        depends on BEET_ENABLE_RELAY_SELF_TEST
        help
            Duration each relay remains active during the self-test sequence.

endmenu
```

## firmware/esp-idf/sdkconfig.defaults
```kconfig
CONFIG_ESPTOOLPY_FLASHSIZE_16MB=y
# CONFIG_ESPTOOLPY_HEADER_FLASHSIZE_UPDATE is not set
CONFIG_BT_ENABLED=y
CONFIG_BT_BLUEDROID_ENABLED=n
CONFIG_BT_NIMBLE_ENABLED=y
CONFIG_BT_NIMBLE_NVS_PERSIST=y
CONFIG_PARTITION_TABLE_CUSTOM=y
CONFIG_PARTITION_TABLE_CUSTOM_FILENAME="partitions/beetmeister.csv"
CONFIG_BOOTLOADER_APP_ROLLBACK_ENABLE=y
CONFIG_BEET_ENABLE_BENCH_DIAGNOSTICS=y
CONFIG_BEET_BENCH_DIAGNOSTIC_PERIOD_S=10
CONFIG_BEET_BOOT_LOW_VOLTAGE_GRACE_MS=5000
CONFIG_BEET_BATTERY_SAMPLE_OVERLAY_COUNT=4
CONFIG_BEET_BATTERY_DIVIDER_SCALE_PERMILLE=2005
CONFIG_BEET_BATTERY_ADC_CALIBRATION_PERMILLE=1030
CONFIG_BEET_MOISTURE_SENSOR_SUPPLY_KNEE_MV=3332
CONFIG_BEET_SENSOR_POWER_GPIO=15
CONFIG_BEET_SENSOR_POWER_SETTLE_MS=50
CONFIG_BEET_BOOST_ENABLE_GPIO=16
CONFIG_BEET_ENABLE_OLED_DISPLAY=y
CONFIG_BEET_OLED_SDA_GPIO=11
CONFIG_BEET_OLED_SCL_GPIO=12
CONFIG_BEET_OLED_I2C_ADDRESS=0x3C
```
